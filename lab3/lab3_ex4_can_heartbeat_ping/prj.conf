## prj.conf
```kconfig
# ---- Cấu hình Kconfig cho ứng dụng BKIT Blinky ----
# Bật driver GPIO để điều khiển chân PE4 (LED3)
CONFIG_GPIO=y

# Bật console UART (in thông báo qua USART1 / RS232)
CONFIG_SERIAL=y
CONFIG_CONSOLE=y
CONFIG_UART_CONSOLE=y
CONFIG_PRINTK=y

# Lab 3: bật driver CAN
CONFIG_CAN=y
```

## src/main.c
```c
/*
 * BKIT ARM4 - Lab 3 - Ex 4: CAN Node Heartbeat and Ping
 * Yeu cau: Heartbeat, ping va giam sat node qua 2 kit bus that
 */

#include <stdio.h>
#include <zephyr/kernel.h>
#include <zephyr/drivers/gpio.h>

/* Khai bao cac den tu Devicetree (app.overlay) */
#define LED0_NODE DT_ALIAS(led0) /* LED3   - PE4 */
#define LED1_NODE DT_ALIAS(led1) /* Out Y0 - PE5 */
#define LED2_NODE DT_ALIAS(led2) /* Out Y1 - PE6 */

static const struct gpio_dt_spec led3 = GPIO_DT_SPEC_GET(LED0_NODE, gpios);
static const struct gpio_dt_spec y0   = GPIO_DT_SPEC_GET(LED1_NODE, gpios);
static const struct gpio_dt_spec y1   = GPIO_DT_SPEC_GET(LED2_NODE, gpios);

int main(void)
{
    printf("Lab 3 - Ex 4: CAN Node Heartbeat and Ping san sang!\n");
    return 0;
}
```
